/*
 * Copyright (c) 2020-2021, NVIDIA CORPORATION.  All rights reserved.
 *
 * This program is free software; you can redistribute it and/or modify it
 * under the terms and conditions of the GNU General Public License,
 * version 2, as published by the Free Software Foundation.
 *
 * This program is distributed in the hope it will be useful, but WITHOUT
 * ANY WARRANTY; without even the implied warranty of MERCHANTABILITY or
 * FITNESS FOR A PARTICULAR PURPOSE.  See the GNU General Public License for
 * more details.
 *
 * You should have received a copy of the GNU General Public License
 * along with this program.  If not, see <http://www.gnu.org/licenses/>.
 */

/*
 * Jetson Device-tree overlay for MCP251x CAN Controller.
 */
/dts-v1/;
/plugin/;

#include <dt-common/jetson/tegra234-p3767-0000-common.h>
#include <dt-bindings/pinctrl/pinctrl-tegra.h>

#include <overlays/jetson-mcp251x-overlay.dtsi>
